## demostracion/poky/build/conf/bblayers.conf
```bitbake
# POKY_BBLAYERS_CONF_VERSION is increased each time build/conf/bblayers.conf
# changes incompatibly
POKY_BBLAYERS_CONF_VERSION = "2"

BBPATH = "${TOPDIR}"
BBFILES ?= ""

BBLAYERS ?= " \
  /home/yoctouser/yocto-workspace/poky/meta \
  /home/yoctouser/yocto-workspace/poky/meta-poky \
  /home/yoctouser/yocto-workspace/poky/meta-yocto-bsp \
  /home/yoctouser/yocto-workspace/poky/meta-raspberrypi \
  /home/yoctouser/yocto-workspace/poky/meta-openembedded/meta-oe \
  /home/yoctouser/yocto-workspace/poky/meta-openembedded/meta-python \
  /home/yoctouser/yocto-workspace/poky/meta-openembedded/meta-networking \
  /home/yoctouser/yocto-workspace/poky/meta-openembedded/meta-multimedia \
  /home/yoctouser/yocto-workspace/poky/build/meta-ai \
  "
```

## demostracion/poky/build/conf/local.conf
```bitbake
# =================================================================
# CONFIGURACIÓN DE HARDWARE Y SISTEMA BASE
# =================================================================

# Define el hardware objetivo (Raspberry Pi 5) para compilar los drivers y kernel específicos.
MACHINE = "raspberrypi5"

# Utiliza la distribución de referencia del Proyecto Yocto.
DISTRO = "poky"

# Formato de paquetes .ipk (ligero), ideal para optimizar espacio en sistemas embebidos.
PACKAGE_CLASSES = "package_ipk"

# =================================================================
# GESTIÓN DE INICIO Y SERVICIOS (SYSTEMD)
# =================================================================

# Habilita systemd como el gestor de sistema para un arranque y control de servicios moderno.
DISTRO_FEATURES:append = " systemd"

# Fusiona directorios de binarios (/bin a /usr/bin) siguiendo estándares modernos de Linux.
DISTRO_FEATURES:append = " usrmerge"

# Define systemd como el manejador de ejecución en tiempo de funcionamiento.
VIRTUAL-RUNTIME_init_manager = "systemd"

# Ignora scripts de inicio antiguos (SysVinit) para evitar conflictos de redundancia.
DISTRO_FEATURES_BACKFILL_CONSIDERED:append = " sysvinit"
VIRTUAL-RUNTIME_initscripts = "systemd-compat-units"

# =================================================================
# CONFIGURACIÓN LOCAL Y PERIFÉRICOS
# =================================================================

# Establece la hora y región local para logs y cronogramas internos.
DEFAULT_TIMEZONE = "America/Costa_Rica"

# Arranca directamente desde el kernel, omitiendo U-Boot para reducir el tiempo de inicio.
RPI_USE_U_BOOT = "0"

# Habilita la comunicación serie por hardware (pines GPIO) para debugeo físico.
ENABLE_UART = "1"

# Activa los buses de comunicación para sensores o dispositivos externos (I2C y SPI).
ENABLE_SPI_BUS = "1"
ENABLE_I2C = "1"

# =================================================================
# ACCESO Y SEGURIDAD DE LA IMAGEN
# =================================================================

# Agrega servidor SSH para acceso remoto y permite acceso 'root' sin clave en desarrollo.
EXTRA_IMAGE_FEATURES += " \
    empty-root-password \
    ssh-server-openssh \
    allow-empty-password \
"

# =================================================================
# RED Y CONECTIVIDAD
# =================================================================

# Paquetes para gestión de red (IP dinámica, rutas y herramientas de diagnóstico).
IMAGE_INSTALL:append = " \
    dhcpcd \
    iproute2 \
    iputils \
    net-tools \
"

# Soporte para actualización de zona horaria y certificados de seguridad web.
IMAGE_INSTALL:append = " tzdata ca-certificates"

# Habilita el stack de WiFi y añade el firmware necesario para el chip inalámbrico de la RPi5.
DISTRO_FEATURES:append = " wifi"
IMAGE_INSTALL:append = " \
    linux-firmware \
    wpa-supplicant \
"

# =================================================================
# UTILIDADES DE TERMINAL Y SISTEMA
# =================================================================

# Instala shell Bash, editores y monitores de recursos (CPU/RAM) esenciales.
IMAGE_INSTALL:append = " \
    bash \
    vim \
    htop \
    procps \
    coreutils \
"

# =================================================================
# MOTOR DE INTELIGENCIA ARTIFICIAL (OLLAMA)
# =================================================================

# Instala Ollama y librerías de C++/computación necesarias para ejecutar modelos LLM.
# numactl optimiza el acceso a la memoria para procesos de alta carga computacional.
IMAGE_INSTALL:append = " ollama libstdc++ libgcc libgomp numactl"

# =================================================================
# ALMACENAMIENTO Y GENERACIÓN DE IMAGEN
# =================================================================

# Genera un archivo .wic comprimido, listo para ser flasheado en una tarjeta MicroSD.
IMAGE_FSTYPES = "wic.bz2"

# Reserva 8GB extras en la partición raíz para alojar modelos de IA y datos de usuario.
IMAGE_ROOTFS_EXTRA_SPACE = "8388608"

# Acepta licencias comerciales/restringidas requeridas para el firmware del WiFi.
LICENSE_FLAGS_ACCEPTED = "synaptics-killswitch commercial"

# =================================================================
# OPTIMIZACIÓN DEL HOST DE COMPILACIÓN (DOCKER/PC)
# =================================================================

# Limita la cantidad de núcleos usados en el build para evitar colapsar la RAM del PC.
BB_NUMBER_PARSE_THREADS = "2"
BB_NUMBER_THREADS = "4"
PARALLEL_MAKE = "-j 4"

# Define rutas para descargas y caché de compilación (ayuda a la persistencia en Docker).
DL_DIR ?= "${TOPDIR}/../downloads"
SSTATE_DIR ?= "${TOPDIR}/../sstate-cache"
TMPDIR = "${TOPDIR}/tmp"

# Versión del archivo para compatibilidad con la versión actual de BitBake.
CONF_VERSION = "2"

# Desactiva la creación de documentos de licencias SPDX para reducir el tiempo de build.
INHERIT:remove = "create-spdx"
```

## demostracion/poky/build/meta-ai/conf/layer.conf
```bitbake
# We have a conf and classes directory, add to BBPATH
BBPATH .= ":${LAYERDIR}"

# We have recipes-* directories, add to BBFILES
BBFILES += "${LAYERDIR}/recipes-*/*/*.bb \
            ${LAYERDIR}/recipes-*/*/*.bbappend"

BBFILE_COLLECTIONS += "meta-ai"
BBFILE_PATTERN_meta-ai = "^${LAYERDIR}/"
BBFILE_PRIORITY_meta-ai = "10"

LAYERDEPENDS_meta-ai = "core raspberrypi"
LAYERSERIES_COMPAT_meta-ai = "scarthgap"
```

## tutorial-guiado/poky/build/conf/local.conf
```bitbake
# ================================================================
#  local.conf — Yocto Scarthgap | genericx86-64 | VirtualBox
# ================================================================

# ----------------------------------------------------------------
# 1. MÁQUINA Y DISTRIBUCIÓN
# ----------------------------------------------------------------
# genericx86-64: target de 64 bits para PC y máquinas virtuales
# El BSP viene incluido en meta-yocto-bsp, no necesita capa extra
MACHINE = "genericx86-64"

# poky es la distribución de referencia de Yocto
DISTRO = "poky"

# IPK es el formato de paquetes estándar en imágenes embebidas
PACKAGE_CLASSES = "package_ipk"

# ----------------------------------------------------------------
# 2. SISTEMA DE INIT: systemd
# ----------------------------------------------------------------
# Reemplaza SysVinit por systemd, necesario para manejar servicios
# como ollama.service de forma automática al encender la VM
DISTRO_FEATURES:append = " systemd"

# usrmerge es requerido por systemd en Scarthgap
# Sin esto, systemd no puede proveer udev y algunos paquetes no se compilan
DISTRO_FEATURES:append = " usrmerge"

VIRTUAL-RUNTIME_init_manager = "systemd"
DISTRO_FEATURES_BACKFILL_CONSIDERED:append = " sysvinit"
VIRTUAL-RUNTIME_initscripts = "systemd-compat-units"

# ----------------------------------------------------------------
# 3. IMAGE FEATURES
# ----------------------------------------------------------------
# empty-root-password: permite hacer login como root sin contraseña
EXTRA_IMAGE_FEATURES += "empty-root-password"

# ----------------------------------------------------------------
# 4. PAQUETES — SISTEMA BASE Y RED
# ----------------------------------------------------------------
IMAGE_INSTALL:append = " \
    bash \
    dhcpcd \
    iproute2 \
    procps \
    coreutils \
    ca-certificates \
    libstdc++ \
    libgcc \
    libgomp \
"

# ----------------------------------------------------------------
# 5. PAQUETE — OLLAMA
# ----------------------------------------------------------------
IMAGE_INSTALL:append = " ollama"

# ----------------------------------------------------------------
# 6. FORMATO DE IMAGEN
# ----------------------------------------------------------------
# wic: genera una imagen de disco completa con tabla de particiones
# Es el formato necesario para convertir luego a vmdk para VirtualBox
IMAGE_FSTYPES = "wic.vmdk wic"

# Espacio extra en el rootfs:
# TinyLlama ocupa ~600 MB; con 4 GB hay margen para el modelo y los logs
# Unidad: KB. 4194304 KB = 4 GB
IMAGE_ROOTFS_EXTRA_SPACE = "4194304"

# ----------------------------------------------------------------
# 7. RENDIMIENTO DE COMPILACIÓN
# ----------------------------------------------------------------
# Ajustar estos valores según los núcleos disponibles en el host
# Con una máquina de 4 núcleos: BB_NUMBER_THREADS = "4", PARALLEL_MAKE = "-j 4"
BB_NUMBER_PARSE_THREADS ?= "2"
BB_NUMBER_THREADS ?= "4"
PARALLEL_MAKE ?= "-j 4"

# ----------------------------------------------------------------
# 8. DIRECTORIOS DE CACHÉ
# ----------------------------------------------------------------
# Coloca downloads y sstate-cache fuera del directorio de build
# para que persistan entre builds y ahorren tiempo de compilación
DL_DIR ?= "${TOPDIR}/../downloads"
SSTATE_DIR ?= "${TOPDIR}/../sstate-cache"
TMPDIR = "${TOPDIR}/tmp"

CONF_VERSION = "2"

# ----------------------------------------------------------------
# 9. FIXES DE BUILD
# ----------------------------------------------------------------
# Desactiva la generación de manifiestos SPDX (licencias)
# Causan colisiones de sstate si se cambian DISTRO_FEATURES entre builds
INHERIT:remove = "create-spdx"

# Desactiva uninative para evitar el error:
#   "patchelf: section header table out of bounds"
# que ocurre cuando patchelf intenta parchear el intérprete ELF de binarios
# nativos (como qemu-system-x86_64) que llegaron ya stripeados al sysroot.
# Uninative no es necesario en un build dentro de Docker porque el entorno
# ya es controlado y reproducible sin necesidad de reescribir el loader.
INHERIT:remove = "uninative"
```

## tutorial-guiado/poky/build/meta-ollama/conf/layer.conf
```bitbake
# Agrega esta capa al BBPATH para que BitBake encuentre sus archivos
BBPATH .= ":${LAYERDIR}"

# Registra todos los archivos .bb y .bbappend dentro de carpetas recipes-*
BBFILES += "${LAYERDIR}/recipes-*/*/*.bb \
            ${LAYERDIR}/recipes-*/*/*.bbappend"

# Nombre único de esta capa
BBFILE_COLLECTIONS += "meta-ollama"

# Patrón que identifica que un archivo pertenece a esta capa
BBFILE_PATTERN_meta-ollama = "^${LAYERDIR}/"

# Prioridad 10: si hay conflicto con una receta de otra capa, gana esta
BBFILE_PRIORITY_meta-ollama = "10"

# Esta capa requiere que la capa "core" esté presente
LAYERDEPENDS_meta-ollama = "core"

# Declara compatibilidad con Yocto Scarthgap
LAYERSERIES_COMPAT_meta-ollama = "scarthgap"
```
